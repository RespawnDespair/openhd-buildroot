## br-external/Config.in
```kconfig
source "$BR2_EXTERNAL_openhd_PATH/package/openhd/Config.in"
source "$BR2_EXTERNAL_openhd_PATH/package/wiringnp/Config.in"
```

## br-external/configs/nanopi_duo2_openhd_defconfig
```kconfig
# https://buildroot.org/downloads/manual/customize-outside-br.txt

BR2_arm=y
BR2_cortex_a7=y
BR2_ARM_FPU_VFPV4=y

BR2_TARGET_GENERIC_HOSTNAME="nanopi-duo2"
BR2_TARGET_GENERIC_ISSUE="Welcome to Buildroot for the NanoPi Duo2"
BR2_ROOTFS_POST_BUILD_SCRIPT="$(BR2_EXTERNAL_openhd_PATH)/board/friendlyarm/nanopi-duo2/post-build.sh"
BR2_ROOTFS_POST_IMAGE_SCRIPT="$(BR2_EXTERNAL_openhd_PATH)/board/friendlyarm/nanopi-duo2/post-image.sh"
BR2_GLOBAL_PATCH_DIR="$(BR2_EXTERNAL_openhd_PATH)/patches/"

# Linux headers same as kernel, a 4.10 series
BR2_PACKAGE_HOST_LINUX_HEADERS_CUSTOM_5_3=y

# Use a -rc kernel to get the DTS
BR2_LINUX_KERNEL=y
BR2_LINUX_KERNEL_CUSTOM_VERSION=y
BR2_LINUX_KERNEL_CUSTOM_VERSION_VALUE="5.3"
BR2_LINUX_KERNEL_DEFCONFIG="sunxi"
BR2_LINUX_KERNEL_DTS_SUPPORT=y
BR2_LINUX_KERNEL_INTREE_DTS_NAME="sun8i-h3-nanopi-duo2"

# Use an -rc tag because the defconfig is very recent
BR2_TARGET_UBOOT=y
BR2_TARGET_UBOOT_BUILD_SYSTEM_KCONFIG=y
BR2_TARGET_UBOOT_CUSTOM_VERSION=y
BR2_TARGET_UBOOT_CUSTOM_VERSION_VALUE="2019.01"
BR2_TARGET_UBOOT_BOARD_DEFCONFIG="nanopi_duo2"
BR2_TARGET_UBOOT_NEEDS_DTC=y
BR2_TARGET_UBOOT_FORMAT_CUSTOM=y
BR2_TARGET_UBOOT_FORMAT_CUSTOM_NAME="u-boot-sunxi-with-spl.bin"



# Build an sdcard image
BR2_TARGET_ROOTFS_EXT2=y
BR2_TARGET_ROOTFS_EXT2_4=y
BR2_TARGET_ROOTFS_EXT2_SIZE="32M"
BR2_TARGET_ROOTFS_EXT2_INODES=8192
# BR2_TARGET_ROOTFS_TAR is not set
BR2_PACKAGE_HOST_DOSFSTOOLS=y
BR2_PACKAGE_HOST_GENIMAGE=y
BR2_PACKAGE_HOST_MTOOLS=y
BR2_PACKAGE_HOST_UBOOT_TOOLS=y


BR2_PACKAGE_ARMBIAN_FIRMWARE=y
BR2_PACKAGE_ARMBIAN_FIRMWARE_AP6212=y

# Systemd for services
BR2_INIT_SYSTEMD=y

# Needed packages
BR2_PACKAGE_AIRCRACK_NG=y
BR2_PACKAGE_WIRELESS_TOOLS=y
BR2_PACKAGE_UTIL_LINUX=y
BR2_PACKAGE_ETHTOOL=y
BR2_PACKAGE_LIBPCAP=y
BR2_PACKAGE_WIRINGNP=y
BR2_PACKAGE_LIBV4L=y
BR2_PACKAGE_LIBV4L_UTILS=y
#BR2_PACKAGE_V4L2LOOPBACK=y
#BR2_PACKAGE_V4L2LOOPBACK_UTILS=y
BR2_PACKAGE_IW=y
BR2_PACKAGE_GSTREAMER1=y
#BR2_PACKAGE_GST1_OMX=y # For Rpi
BR2_PACKAGE_GST1_PLUGINS_BAD=y
BR2_PACKAGE_GST1_PLUGINS_BASE=y
BR2_PACKAGE_GST1_PLUGINS_GOOD=y
BR2_PACKAGE_GST1_PLUGINS_UGLY=y
BR2_PACKAGE_GST1_LIBAV=y
BR2_PACKAGE_GST1_INTERPIPE=y
BR2_PACKAGE_GST1_RTSP_SERVER=y # not sure
BR2_PACKAGE_USBMOUNT=y
BR2_PACKAGE_DOSFSTOOLS=y
BR2_PACKAGE_DOS2UNIX=y
BR2_PACKAGE_LIBTOOL=y
BR2_PACKAGE_HOSTAPD=y
BR2_PACKAGE_LIBUSB=y
BR2_PACKAGE_OMXPLAYER=y # Only needed for smartsync video
BR2_PACKAGE_I2C_TOOLS=y

# Openhd specific packages
BR2_PACKAGE_OPENHD_CORE=y
BR2_PACKAGE_OPENHD_RTL88XX=y
```

## br-external/configs/raspberrypi0w_openhd_defconfig
```kconfig
BR2_arm=y
BR2_arm1176jzf_s=y
BR2_ARM_EABIHF=y

# Linux headers same as kernel, a 4.19 series
BR2_PACKAGE_HOST_LINUX_HEADERS_CUSTOM_4_19=y

BR2_TOOLCHAIN_BUILDROOT_CXX=y

BR2_LINUX_KERNEL=y
BR2_LINUX_KERNEL_CUSTOM_TARBALL=y
BR2_LINUX_KERNEL_CUSTOM_TARBALL_LOCATION="$(call github,raspberrypi,linux,raspberrypi-kernel_1.20190819-1)/linux-raspberrypi-kernel_1.20190819-1.tar.gz"
BR2_LINUX_KERNEL_DEFCONFIG="bcmrpi"
BR2_LINUX_KERNEL_DTS_SUPPORT=y
BR2_LINUX_KERNEL_INTREE_DTS_NAME="bcm2708-rpi-zero-w"
BR2_LINUX_KERNEL_NEEDS_HOST_OPENSSL=y


# Required tools to create the SD image
BR2_PACKAGE_HOST_DOSFSTOOLS=y
BR2_PACKAGE_HOST_GENIMAGE=y
BR2_PACKAGE_HOST_MTOOLS=y

# Filesystem / image
BR2_TARGET_ROOTFS_EXT2=y
BR2_TARGET_ROOTFS_EXT2_4=y
BR2_TARGET_ROOTFS_EXT2_SIZE="120M"
# BR2_TARGET_ROOTFS_TAR is not set
BR2_ROOTFS_POST_BUILD_SCRIPT="board/raspberrypi0w/post-build.sh"
BR2_ROOTFS_POST_IMAGE_SCRIPT="board/raspberrypi0w/post-image.sh"
BR2_ROOTFS_POST_SCRIPT_ARGS="--add-pi3-miniuart-bt-overlay"

# Systemd for services
BR2_INIT_SYSTEMD=y

# Toolchain needs to be glibc
# BR2_TOOLCHAIN_BUILDROOT_UCLIBC is not set
BR2_TOOLCHAIN_BUILDROOT_GLIBC=y
# BR2_TOOLCHAIN_BUILDROOT_MUSL is not set
BR2_TOOLCHAIN_BUILDROOT_LIBC="glibc"
BR2_PACKAGE_LINUX_HEADERS=y
BR2_PACKAGE_GLIBC=y
# BR2_GLIBC_VERSION_2_22 is not set
BR2_GLIBC_VERSION_2_23=y
BR2_GLIBC_VERSION_STRING="2.23"

# Needed packages
BR2_PACKAGE_RPI_FIRMWARE=y
BR2_PACKAGE_WIRINGPI=y
BR2_PACKAGE_AIRCRACK_NG=y
BR2_PACKAGE_WIRELESS_TOOLS=y
BR2_PACKAGE_UTIL_LINUX=y
BR2_PACKAGE_ETHTOOL=y
BR2_PACKAGE_LIBPCAP=y
BR2_PACKAGE_LIBV4L=y
BR2_PACKAGE_LIBV4L_UTILS=y
BR2_PACKAGE_V4L2LOOPBACK=y
BR2_PACKAGE_V4L2LOOPBACK_UTILS=y
BR2_PACKAGE_IW=y
BR2_PACKAGE_GSTREAMER1=y
BR2_PACKAGE_GST1_OMX=y # For Rpi
BR2_PACKAGE_GST1_PLUGINS_BAD=y
BR2_PACKAGE_GST1_PLUGINS_BASE=y
BR2_PACKAGE_GST1_PLUGINS_GOOD=y
BR2_PACKAGE_GST1_PLUGINS_UGLY=y
BR2_PACKAGE_GST1_LIBAV=y
BR2_PACKAGE_GST1_INTERPIPE=y
BR2_PACKAGE_GST1_RTSP_SERVER=y # not sure
BR2_PACKAGE_USBMOUNT=y
BR2_PACKAGE_DOSFSTOOLS=y
BR2_PACKAGE_DOS2UNIX=y
BR2_PACKAGE_LIBTOOL=y
BR2_PACKAGE_HOSTAPD=y
BR2_PACKAGE_LIBUSB=y
BR2_PACKAGE_OMXPLAYER=y # Only needed for smartsync video
BR2_PACKAGE_I2C_TOOLS=y

# Openhd specific packages
BR2_PACKAGE_OPENHD_CORE=y
BR2_PACKAGE_OPENHD_RTL88XX=y

# Kernel config for openhd raspberrypi0w
BR2_LINUX_KERNEL_CONFIG_FRAGMENT_FILES="$(BR2_EXTERNAL_openhd_PATH)/kernelconfigs/raspberrypi0.frag"
```

## br-external/package/openhd/Config.in
```kconfig
source "$BR2_EXTERNAL_openhd_PATH/package/openhd/openhd-core/Config.in"
source "$BR2_EXTERNAL_openhd_PATH/package/openhd/openhd-rtl88xx/Config.in"
```
